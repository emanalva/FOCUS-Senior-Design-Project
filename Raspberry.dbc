VERSION ""

NS_ :

BS_:

BU_:

BO_ 256 Enc1: 1 Vector__XXX
	SG_ Angle : 0|1@1+ (0,0) [0|360] "Degrees" Vector__XXX

BO_ 336 Curr1: 1 Vector__XXX
	SG_ Current : 0|8@1+ (0.00390625,0) [0|4] "A" Vector__XXX

BO_ 512 Enc2: 1 Vector__XXX
	SG_ Angle : 0|8@1+ (0,0) [0|360] "Degreese" Vector__XXX

BO_ 592 Curr2: 1 Vector__XXX
	SG_ Current : 0|0@1+ (8,0) [0|10] "A" Vector__XXX

BO_ 768 Enc3: 1 Vector__XXX
	SG_ Angle : 0|8@1+ (0,0) [0|360] "" Vector__XXX

BO_ 848 Curr3: 1 Vector__XXX
	SG_ Current : 0|0@1+ (0,0) [0|10] "A" Vector__XXX

CM_ BO_ 256 "G1 encoder";
CM_ BO_ 336 "G1 current sensor";
CM_ SG_ 336 Current "Current sensed through the project";
CM_ BO_ 512 "G2 encoder";
CM_ BO_ 592 "G2 current sensor";
CM_ BO_ 768 "G3 encoder";
CM_ BO_ 848 "G3 current sensor";
BA_DEF_ SG_  "SPN" INT 0 524287;
BA_DEF_ BO_  "VFrameFormat" ENUM  "StandardCAN","ExtendedCAN","reserved","J1939PG";
BA_DEF_  "DatabaseVersion" STRING ;
BA_DEF_  "BusType" STRING ;
BA_DEF_  "ProtocolType" STRING ;
BA_DEF_  "DatabaseCompiler" STRING ;
BA_DEF_DEF_  "SPN" 0;
BA_DEF_DEF_  "VFrameFormat" "J1939PG";
BA_DEF_DEF_  "DatabaseVersion" "DEMO PLUS";
BA_DEF_DEF_  "BusType" "";
BA_DEF_DEF_  "ProtocolType" "";
BA_DEF_DEF_  "DatabaseCompiler" "";
BA_ "ProtocolType" "J1939";
BA_ "BusType" "CAN";
BA_ "DatabaseCompiler" "CSS ELECTRONICS (WWW.CSSELECTRONICS.COM)";
BA_ "DatabaseVersion" "1.0.0";
BA_ "SPN" SG_ 2566844926 WheelBasedVehicleSpeed 84;
